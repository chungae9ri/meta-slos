## conf/layer.conf
```bitbake
BBPATH .= ":${LAYERDIR}"
BBFILES += "${LAYERDIR}/recipes-*/*/*.bb"
# append layer name to list of configured layers
BBFILE_COLLECTIONS += "slos"
# and use name as suffix for other properties
BBFILE_PATTERN_slos = "^${LAYERDIR}/"
BBFILE_PRIORITY_slos = "5"
LAYERSERIES_CORENAMES = "slos"
LAYERVERSION_slos = "1"
LAYERSERIES_COMPAT_slos = "slos"
```
